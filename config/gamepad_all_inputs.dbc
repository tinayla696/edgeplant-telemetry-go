VERSION "edgeplant-gamepad-all-inputs"

NS_ :

BS_:

BU_: ECU

BO_ 528 GamepadMsg: 8 ECU
 SG_ StickLX : 0|8@1- (1,0) [-128|127] "" ECU
 SG_ StickLY : 8|8@1- (1,0) [-128|127] "" ECU
 SG_ StickRX : 16|8@1- (1,0) [-128|127] "" ECU
 SG_ StickRY : 24|8@1- (1,0) [-128|127] "" ECU
 SG_ Btn00_P : 32|1@1+ (1,0) [0|1] "" ECU
 SG_ Btn01_P : 33|1@1+ (1,0) [0|1] "" ECU
 SG_ Btn02_P : 34|1@1+ (1,0) [0|1] "" ECU
 SG_ Btn03_P : 35|1@1+ (1,0) [0|1] "" ECU
 SG_ Btn04_P : 36|1@1+ (1,0) [0|1] "" ECU
 SG_ Btn05_P : 37|1@1+ (1,0) [0|1] "" ECU
 SG_ Btn06_P : 38|1@1+ (1,0) [0|1] "" ECU
 SG_ Btn07_P : 39|1@1+ (1,0) [0|1] "" ECU
 SG_ Btn08_P : 40|1@1+ (1,0) [0|1] "" ECU
 SG_ Btn09_P : 41|1@1+ (1,0) [0|1] "" ECU
 SG_ Btn10_P : 42|1@1+ (1,0) [0|1] "" ECU
 SG_ Btn11_P : 43|1@1+ (1,0) [0|1] "" ECU
 SG_ Btn12_P : 44|1@1+ (1,0) [0|1] "" ECU
 SG_ Btn13_P : 45|1@1+ (1,0) [0|1] "" ECU
 SG_ Btn14_P : 46|1@1+ (1,0) [0|1] "" ECU
 SG_ Btn15_P : 47|1@1+ (1,0) [0|1] "" ECU
